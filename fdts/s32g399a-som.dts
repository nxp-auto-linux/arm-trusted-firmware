// SPDX-License-Identifier: (GPL-2.0+ OR BSD-3-Clause)
/*
 * Device Tree file for S32G3-VC-SOM board.
 *
 * Copyright 2024 NXP
 */

/dts-v1/;

#include "s32g399a-som.dtsi"

/ {
	model = "NXP S32G3-VC-SOM Board";
	compatible = "nxp,s32g399a-som", "nxp,s32g3";

	chosen {
		stdout-path = "serial0:115200n8";
	};
};

