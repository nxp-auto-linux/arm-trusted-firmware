// SPDX-License-Identifier: (GPL-2.0+ OR BSD-3-Clause)
/*
 * Copyright 2023,2025-2026 NXP
 */

/dts-v1/;
#include "s32g-pfe-slave.dtsi"
#include "s32g3.dtsi"
#include "s32gxxxa-rdb.dtsi"

/ {
	model = "NXP S32G399A-RDB3";
};

&qspi {
	status = "okay";
};

&usdhc0 {
	mmc-hs200-1_8v;
	mmc-hs400-1_8v;
	mmc-hs400-enhanced-strobe;
	/* Remove no-1-8-v to enable higher speed modes for SD card such as: SDR50 or DDR50
	 * or eMMC memory, such as HS200, HS400 or HS400 ES respectively.
	 */
	no-1-8-v;
};
