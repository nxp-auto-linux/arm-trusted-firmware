// SPDX-License-Identifier: (GPL-2.0+ OR BSD-3-Clause)
/*
 * Copyright 2025 NXP
 */

/dts-v1/;
#include "s32g2.dtsi"
#include "s32g-pfe-slave.dtsi"
#include "s32gxxxa-rdb.dtsi"

/ {
	model = "NXP S32G274A-RDB2";
};

&qspi {
	status = "okay";
};

&usdhc0 {
	no-1-8-v;
};
